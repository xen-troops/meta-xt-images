## doc/conf/bblayers.conf
```bitbake
BBPATH = "${TOPDIR}"
BBFILES ?= ""

BBLAYERS ?= " \
  ${TOPDIR}/../xt-distro/meta \
  ${TOPDIR}/../meta-xt-images \
  "
```

## machine/meta-rcar-gen3-xen/conf/machine/h3ulcb-domx.conf
```bitbake
#@TYPE: Machine
#@NAME: H3ULCB DomX machine
#@DESCRIPTION: Machine configuration for running xen domain on H3ULCB

require conf/machine/include/rcar.inc
require conf/machine/include/domx.inc

KERNEL_DEVICETREE = "renesas/r8a7795-h3ulcb-dom0.dtb"

UBOOT_MACHINE = "h3ulcb_defconfig"

MACHINEOVERRIDES .= ":ulcb"
```

## machine/meta-rcar-gen3-xen/conf/machine/h3ulcb-xt.conf
```bitbake
#@TYPE: Machine
#@NAME: H3ULCB machine
#@DESCRIPTION: Machine configuration for running xen domain on H3ULCB

SOC_FAMILY = "r8a7795"

require conf/machine/include/rcar.inc
require conf/machine/include/domx.inc

KERNEL_DEVICETREE = "renesas/r8a7795-h3ulcb-dom0.dtb"

UBOOT_MACHINE = "h3ulcb_defconfig"

MACHINEOVERRIDES .= ":ulcb"
```

## machine/meta-rcar-gen3-xen/conf/machine/m3ulcb-domx.conf
```bitbake
#@TYPE: Machine
#@NAME: M3ULCB DomX machine
#@DESCRIPTION: Machine configuration for running xen domain on M3ULCB

require conf/machine/include/rcar.inc
require conf/machine/include/domx.inc

KERNEL_DEVICETREE = "renesas/r8a7796-m3ulcb-dom0.dtb"

UBOOT_MACHINE = "m3ulcb_defconfig"

MACHINEOVERRIDES .= ":ulcb"
```

## machine/meta-rcar-gen3-xen/conf/machine/m3ulcb-xt.conf
```bitbake
#@TYPE: Machine
#@NAME: M3ULCB machine
#@DESCRIPTION: Machine configuration for running xen domain on M3ULCB

SOC_FAMILY = "r8a7796"

require conf/machine/include/rcar.inc
require conf/machine/include/domx.inc

KERNEL_DEVICETREE = "renesas/r8a7796-m3ulcb-dom0.dtb"

UBOOT_MACHINE = "m3ulcb_defconfig"

MACHINEOVERRIDES .= ":ulcb"
```

## machine/meta-rcar-gen3-xen/conf/machine/salvator-x-domx.conf
```bitbake
#@TYPE: Machine
#@NAME: Salvator-X DomX machine
#@DESCRIPTION: Machine configuration for running xen domain on Salvator-X

require conf/machine/include/rcar.inc
require conf/machine/include/domx.inc

# Device tree for H3
KERNEL_DEVICETREE_r8a7795 = " \
    renesas/r8a7795-salvator-x-dom0.dtb \
    renesas/r8a7795-salvator-x-domu.dtb \
"
# Device tree for M3
KERNEL_DEVICETREE_r8a7796 = "renesas/r8a7796-salvator-x-dom0.dtb"

# H3 u-boot configure
UBOOT_MACHINE_r8a7795 = "r8a7795_salvator-x_defconfig"
# M3 u-boot configure
UBOOT_MACHINE_r8a7796 = "r8a7796_salvator-x_defconfig"
```

## machine/meta-rcar-gen3-xen/conf/machine/salvator-x-h3-xt.conf
```bitbake
#@TYPE: Machine
#@NAME: Salvator-X H3 machine
#@DESCRIPTION: Machine configuration for running xen domain on Salvator-X H3

require conf/machine/include/rcar.inc
require conf/machine/include/domx.inc

# Device tree for H3
KERNEL_DEVICETREE_r8a7795 = " \
    renesas/r8a7795-salvator-x-dom0.dtb \
    renesas/r8a7795-salvator-x-domu.dtb \
"
# H3 u-boot configure
UBOOT_MACHINE_r8a7795 = "r8a7795_salvator-x_defconfig"
```

## machine/meta-rcar-gen3-xen/conf/machine/salvator-x-m3-xt.conf
```bitbake
#@TYPE: Machine
#@NAME: Salvator-X M3 machine
#@DESCRIPTION: Machine configuration for running xen domain on Salvator-X M3

SOC_FAMILY = "r8a7796"

require conf/machine/include/rcar.inc
require conf/machine/include/domx.inc

# Device tree for M3
KERNEL_DEVICETREE_r8a7796 = "renesas/r8a7796-salvator-x-dom0.dtb"

# M3 u-boot configure
UBOOT_MACHINE_r8a7796 = "r8a7796_salvator-x_defconfig"
```

## machine/meta-rcar-gen3/conf/machine/h3ulcb-xt.conf
```bitbake
#@TYPE: Machine
#@NAME: H3ULCB machine
#@DESCRIPTION: Machine configuration for running xen domain on H3ULCB

SOC_FAMILY = "r8a7795"

require conf/machine/include/rcar.inc
require conf/machine/include/domx.inc

UBOOT_MACHINE = "h3ulcb_defconfig"

MACHINEOVERRIDES .= ":ulcb"
```

## machine/meta-rcar-gen3/conf/machine/salvator-x-m3-xt.conf
```bitbake
#@TYPE: Machine
#@NAME: Salvator-X M3 machine
#@DESCRIPTION: Machine configuration for running xen domain on Salvator-X M3

SOC_FAMILY = "r8a7796"

require conf/machine/include/rcar.inc

# M3 u-boot configure
UBOOT_MACHINE = "r8a7796_salvator-x_defconfig"

MACHINEOVERRIDES .= ":rcar"
```

## machine/meta-xt-images-generic-armv8/conf/layer.conf
```bitbake
# We have a conf and classes directory, add to BBPATH
BBPATH .= ":${LAYERDIR}"

# We have recipes-* directories, add to BBFILES
BBFILES += "\
    ${LAYERDIR}/recipes-*/*/*.bb \
    ${LAYERDIR}/recipes-*/*/*.bbappend \
    "

BBFILE_COLLECTIONS += "generic-armv8"
BBFILE_PATTERN_generic-armv8 = "^${LAYERDIR}/"
BBFILE_PRIORITY_generic-armv8 = "10"

LAYERDEPENDS_generic-armv8 = "meta-arm"

# There are multiple providers available for iasl-native,
# e.g. iasl-native, acpica-native. Select iasl explicitly.
PREFERRED_PROVIDER_iasl-native = "iasl-native"

LAYERSERIES_COMPAT_generic-armv8 = "sumo thud zeus dunfell"
```

## machine/meta-xt-images-generic-armv8/conf/machine/generic-armv8-xt.conf
```bitbake
#@TYPE: Machine
#@NAME: generic armv8 machine
#@DESCRIPTION: Machine configuration for running a generic armv8

require conf/machine/include/arm/arch-armv8.inc

KERNEL_IMAGETYPE = "Image"
IMAGE_FSTYPES = "tar.bz2"

MACHINE_FEATURES_BACKFILL_CONSIDERED = "rtc"
```

## machine/meta-xt-images-rcar-gen3/conf/layer.conf
```bitbake
# We have a conf and classes directory, add to BBPATH
BBPATH .= ":${LAYERDIR}"

# We have recipes-* directories, add to BBFILES
BBFILES += "${LAYERDIR}/recipes-*/*/*.bb \
    ${LAYERDIR}/recipes-*/*/*.bbappend"

BBFILE_COLLECTIONS += "rcar-gen3-xen"
BBFILE_PATTERN_rcar-gen3-xen = "^${LAYERDIR}/"
BBFILE_PRIORITY_rcar-gen3-xen = "6"

PREFERRED_PROVIDER_iasl = "iasl-native"
PREFERRED_PROVIDER_iasl-native = "iasl-native"

LAYERSERIES_COMPAT_rcar-gen3-xen = "rocko sumo thud zeus dunfell"
```

## machine/meta-xt-images-rcar-gen3/conf/machine/h3ulcb-4x2g-ab-xt.conf
```bitbake
#@TYPE: Machine
#@NAME: H3ULCB ES3.0 8GB Aos box machine
#@DESCRIPTION: Machine configuration for running xen domain on H3ULCB ES3.0 8GB Aos box 

require h3ulcb-4x2g-xt.conf

XT_CANONICAL_MACHINE_NAME = "h3ulcb-4x2g-ab"

MACHINEOVERRIDES .= ":aosbox"
```

## machine/meta-xt-images-rcar-gen3/conf/machine/h3ulcb-4x2g-kf-xt.conf
```bitbake
#@TYPE: Machine
#@NAME: H3ULCB ES3.0 8GB Kingfisher machine
#@DESCRIPTION: Machine configuration for running xen domain on H3ULCB ES3.0 8GB Kingfisher

require h3ulcb-4x2g-xt.conf

XT_CANONICAL_MACHINE_NAME = "h3ulcb-4x2g-kf"

MACHINEOVERRIDES .= ":kingfisher"
```

## machine/meta-xt-images-rcar-gen3/conf/machine/h3ulcb-4x2g-xt.conf
```bitbake
#@TYPE: Machine
#@NAME: H3ULCB ES3.0 8GB machine
#@DESCRIPTION: Machine configuration for running xen domain on H3ULCB ES3.0 8GB

SOC_FAMILY = "r8a7795"

XT_CANONICAL_MACHINE_NAME = "h3ulcb-4x2g"

require conf/machine/include/rcar.inc

UBOOT_MACHINE = "rcar3_ulcb_defconfig"

MACHINEOVERRIDES .= ":ulcb:rcar:r8a7795-es3"
```

## machine/meta-xt-images-rcar-gen3/conf/machine/h3ulcb-cb-xt.conf
```bitbake
#@TYPE: Machine
#@NAME: H3ULCB ES2.0 Cetibox machine
#@DESCRIPTION: Machine configuration for running xen domain on H3ULCB ES2.0 Cetibox
SOC_FAMILY = "r8a7795"

require conf/machine/include/rcar.inc

UBOOT_MACHINE = "r8a7795_cetibox_h3ulcb_defconfig"

MACHINEOVERRIDES .= ":ulcb:rcar:r8a7795-es2:cetibox"

XT_CANONICAL_MACHINE_NAME = "h3ulcb-cb"
```

## machine/meta-xt-images-rcar-gen3/conf/machine/h3ulcb-xt.conf
```bitbake
#@TYPE: Machine
#@NAME: H3ULCB machine
#@DESCRIPTION: Machine configuration for running xen domain on H3ULCB

SOC_FAMILY = "r8a7795"

XT_CANONICAL_MACHINE_NAME = "h3ulcb"

require conf/machine/include/rcar.inc

UBOOT_MACHINE = "r8a7795_ulcb_defconfig"

MACHINEOVERRIDES .= ":ulcb:rcar:r8a7795-es2"
```

## machine/meta-xt-images-rcar-gen3/conf/machine/include/rcar.inc
```bitbake
DEFAULTTUNE ?= "cortexa57-cortexa53"
require conf/machine/include/tune-cortexa57-cortexa53.inc
require conf/machine/include/${SOC_FAMILY}.inc

# 32BIT package install (default is disable)
# This variables can be used only in multilib.
USE_32BIT_PKGS ?= "0"
USE_32BIT_WAYLAND ?= "0"
USE_32BIT_MMP ?= "0"

MACHINE_FEATURES = "usb3"

KERNEL_IMAGETYPE = "Image"
IMAGE_FSTYPES = "tar.bz2"

SERIAL_CONSOLE ?= "115200 ttySC0"

# Configuration for kernel
PREFERRED_PROVIDER_virtual/kernel = "linux-renesas"

# Add variable to Build Configuration in build log
BUILDCFG_VARS_append = " SOC_FAMILY"
```

## machine/meta-xt-images-rcar-gen3/conf/machine/m3ulcb-xt.conf
```bitbake
#@TYPE: Machine
#@NAME: M3ULCB machine
#@DESCRIPTION: Machine configuration for running xen domain on M3ULCB

SOC_FAMILY = "r8a7796"

XT_CANONICAL_MACHINE_NAME = "m3ulcb"

require conf/machine/include/rcar.inc

UBOOT_MACHINE = "m3ulcb_defconfig"

MACHINEOVERRIDES .= ":ulcb:rcar"
```

## machine/meta-xt-images-rcar-gen3/conf/machine/salvator-x-h3-4x2g-xt.conf
```bitbake
#@TYPE: Machine
#@NAME: Salvator-X H3 ES3.0 8GB machine
#@DESCRIPTION: Machine configuration for running xen domain on Salvator-X H3 ES3.0 8GB

SOC_FAMILY = "r8a7795"

XT_CANONICAL_MACHINE_NAME = "salvator-x-4x2g"

require conf/machine/include/rcar.inc

# H3 u-boot configure
UBOOT_MACHINE = "rcar3_salvator-x_defconfig"

MACHINEOVERRIDES .= ":salvator:rcar:r8a7795-es3"
```

## machine/meta-xt-images-rcar-gen3/conf/machine/salvator-x-h3-xt.conf
```bitbake
#@TYPE: Machine
#@NAME: Salvator-X H3 machine
#@DESCRIPTION: Machine configuration for running xen domain on Salvator-X H3

SOC_FAMILY = "r8a7795"

require conf/machine/include/rcar.inc

# H3 u-boot configure
UBOOT_MACHINE = "r8a7795_salvator-x_defconfig"

MACHINEOVERRIDES .= ":rcar"
```

## machine/meta-xt-images-rcar-gen3/conf/machine/salvator-x-m3-xt.conf
```bitbake
#@TYPE: Machine
#@NAME: Salvator-X M3 machine
#@DESCRIPTION: Machine configuration for running xen domain on Salvator-X M3

SOC_FAMILY = "r8a7796"

XT_CANONICAL_MACHINE_NAME = "salvator-x"

require conf/machine/include/rcar.inc

# M3 u-boot configure
UBOOT_MACHINE = "r8a7796_salvator-x_defconfig"

MACHINEOVERRIDES .= ":salvator:rcar"
```

## machine/meta-xt-images-rcar-gen3/conf/machine/salvator-x-m3n-xt.conf
```bitbake
#@TYPE: Machine
#@NAME: Salvator-X M3N machine
#@DESCRIPTION: Machine configuration for running xen domain on Salvator-X M3N

SOC_FAMILY = "r8a77965"

XT_CANONICAL_MACHINE_NAME = "salvator-x"

require conf/machine/include/rcar.inc

# M3N u-boot configure
UBOOT_MACHINE = "r8a77965_salvator-x_defconfig"

MACHINEOVERRIDES .= ":salvator:rcar"
```
