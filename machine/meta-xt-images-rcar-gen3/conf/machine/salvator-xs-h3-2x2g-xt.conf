## machine/meta-xt-images-rcar-gen3/conf/machine/salvator-xs-h3-2x2g-xt.conf
```bitbake
#@TYPE: Machine
#@NAME: Salvator-XS H3 ES3.0 4GB machine
#@DESCRIPTION: Machine configuration for running xen domain on Salvator-X H3 ES3.0 4GB

SOC_FAMILY = "r8a7795"

XT_CANONICAL_MACHINE_NAME = "salvator-xs-2x2g"

require conf/machine/include/rcar.inc

# H3 u-boot configure
UBOOT_MACHINE = "r8a7795_salvator-x_defconfig"

MACHINEOVERRIDES .= ":salvator:rcar:r8a7795-es3"
```

## machine/meta-xt-images-rcar-gen3/conf/machine/salvator-xs-h3-4x2g-xt.conf
```bitbake
#@TYPE: Machine
#@NAME: Salvator-XS H3 ES3.0 8GB machine
#@DESCRIPTION: Machine configuration for running xen domain on Salvator-X H3 ES3.0 8GB

SOC_FAMILY = "r8a7795"

XT_CANONICAL_MACHINE_NAME = "salvator-xs-4x2g"

require conf/machine/include/rcar.inc

# H3 u-boot configure
UBOOT_MACHINE = "rcar3_salvator-x_defconfig"

MACHINEOVERRIDES .= ":salvator:rcar:r8a7795-es3"
```

## machine/meta-xt-images-rcar-gen3/conf/machine/salvator-xs-h3-xt.conf
```bitbake
#@TYPE: Machine
#@NAME: Salvator-XS H3 machine
#@DESCRIPTION: Machine configuration for running xen domain on Salvator-XS H3

SOC_FAMILY = "r8a7795"

XT_CANONICAL_MACHINE_NAME = "salvator-xs"

require conf/machine/include/rcar.inc

# H3 u-boot configure
UBOOT_MACHINE = "r8a7795_salvator-x_defconfig"

MACHINEOVERRIDES .= ":salvator:rcar"
```

## machine/meta-xt-images-rcar-gen3/conf/machine/salvator-xs-m3-2x4g-xt.conf
```bitbake
#@TYPE: Machine
#@NAME: Salvator-XS M3 ES3.0 8GB machine
#@DESCRIPTION: Machine configuration for running xen domain on Salvator-X M3 ES3.0 8GB

SOC_FAMILY = "r8a7796"

XT_CANONICAL_MACHINE_NAME = "salvator-xs-2x4g"

require conf/machine/include/rcar.inc

# H3 u-boot configure
UBOOT_MACHINE = "r8a7796_salvator-xs-2x4g_defconfig"

MACHINEOVERRIDES .= ":salvator:rcar:r8a7796-es3"
```

## machine/meta-xt-images-rcar-gen3/conf/machine/salvator-xs-m3n-xt.conf
```bitbake
#@TYPE: Machine
#@NAME: Salvator-XS M3N machine
#@DESCRIPTION: Machine configuration for running xen domain on Salvator-XS M3N

SOC_FAMILY = "r8a77965"

XT_CANONICAL_MACHINE_NAME = "salvator-xs"

require conf/machine/include/rcar.inc

# M3N u-boot configure
UBOOT_MACHINE = "r8a77965_salvator-xs_defconfig"

MACHINEOVERRIDES .= ":salvator:rcar"
```

## recipes-domx/meta-xt-images-domx/conf/layer.conf
```bitbake
# We have a conf and classes directory, add to BBPATH
BBPATH =. "${LAYERDIR}:"

# We have recipes-* directories, add to BBFILES
BBFILES += "${LAYERDIR}/recipes-*/*/*.bb \
            ${LAYERDIR}/recipes-*/*/*.bbappend"

BBFILE_COLLECTIONS += "meta-xt-images-domx"
BBFILE_PATTERN_meta-xt-images-domx = "^${LAYERDIR}/"
BBFILE_PRIORITY_meta-xt-images-domx = "6"

LAYERSERIES_COMPAT_meta-xt-images-domx = "rocko sumo thud zeus dunfell"
```
